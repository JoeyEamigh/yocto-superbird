## examples/meta-superbird-kiosk-example/conf/distro/superbird-kiosk.conf
```bitbake
require conf/distro/superbird.conf

DISTRO = "superbird-kiosk"
DISTRO_NAME = "Superbird Kiosk Example"
DISTRO_VERSION = "0.1.0"

# identity / brand. override per your product.
SUPERBIRD_HOSTNAME = "superbird-kiosk"
SUPERBIRD_MDNS_SERVICE_NAME = "Superbird Kiosk"
SUPERBIRD_USB_GADGET_NAME = "superbird-kiosk"
SUPERBIRD_USB_GADGET_MANUFACTURER = "superbird-kiosk"
SUPERBIRD_USB_GADGET_PRODUCT = "Superbird Kiosk"

# baked into chromium-kiosk at do_install. point at your webapp.
CHROMIUM_KIOSK_URL = "file:///usr/share/superbird-kiosk-default/index.html"
```

## examples/meta-superbird-kiosk-example/conf/layer.conf
```bitbake
BBPATH .= ":${LAYERDIR}"
BBFILES += "${LAYERDIR}/recipes-*/*/*.bb ${LAYERDIR}/recipes-*/*/*.bbappend"

BBFILE_COLLECTIONS += "superbird-kiosk-example"
BBFILE_PATTERN_superbird-kiosk-example := "^${LAYERDIR}/"
BBFILE_PRIORITY_superbird-kiosk-example = "8"

LAYERVERSION_superbird-kiosk-example = "1"
LAYERSERIES_COMPAT_superbird-kiosk-example = "wrynose"
LAYERDEPENDS_superbird-kiosk-example = "core superbird meson chromium-browser-layer"
```

## meta-bridgething/conf/distro/bridgething.conf
```bitbake
require conf/distro/superbird.conf

DISTRO = "bridgething"
DISTRO_NAME = "Bridgething"
DISTRO_VERSION = "0.1.4"

# --- identity / brand overrides ---
SUPERBIRD_HOSTNAME = "bridgething"
SUPERBIRD_MDNS_SERVICE_NAME = "Bridgething"
SUPERBIRD_USB_GADGET_NAME = "bridgething"
SUPERBIRD_USB_GADGET_MANUFACTURER = "bridgething"
SUPERBIRD_USB_GADGET_PRODUCT = "Bridgething Superbird"
SUPERBIRD_BOOT_LOGO_NAME = "bridgething-bootup.bmp"
SUPERBIRD_WESTON_SPLASH_IMAGE = "bridgething-splash.png"

# --- chromium kiosk: point at the daemon's loopback HTTP listener; route through the BT-RFCOMM SOCKS bridge ---
CHROMIUM_KIOSK_URL = "http://127.0.0.1:8891/"
CHROMIUM_KIOSK_PROXY_SERVER = "socks5://127.0.0.1:1080"
```

## meta-bridgething/conf/layer.conf
```bitbake
BBPATH .= ":${LAYERDIR}"

BBFILES += "${LAYERDIR}/recipes-*/*/*.bb \
            ${LAYERDIR}/recipes-*/*/*.bbappend"

BBFILE_COLLECTIONS += "bridgething"
BBFILE_PATTERN_bridgething = "^${LAYERDIR}/"
BBFILE_PRIORITY_bridgething = "20"

LAYERSERIES_COMPAT_bridgething = "scarthgap wrynose"

LAYERDEPENDS_bridgething = "core superbird"
```

## meta-superbird/conf/distro/superbird.conf
```bitbake
require conf/distro/poky.conf

DISTRO = "superbird"
DISTRO_NAME = "Superbird"
DISTRO_VERSION = "0.1.0"

MAINTAINER = "Joey Eamigh <55670930+JoeyEamigh@users.noreply.github.com>"

INIT_MANAGER = "systemd"

DISTRO_FEATURES:append = " wayland opengl"
DISTRO_FEATURES:remove = "x11 3g nfc wifi vulkan pulseaudio multiarch nfs zeroconf debuginfod ptest"

PACKAGE_CLASSES = "package_ipk"

# weston: dev image opts in to vnc via the bbappend's split package; prod stays clean
PACKAGECONFIG:append:pn-weston = " headless vnc"

# pin aml back to 0.3.0 to satisfy weston-15's range; drop when weston widens
PREFERRED_VERSION_aml = "0.3.0"

# pin swupdate to the same release the daemon's swupdate-sys submodule tracks. bump together.
PREFERRED_VERSION_swupdate = "2025.12"

# chromium cast_shell variant; bbappend defines the PACKAGECONFIG
PACKAGECONFIG:pn-chromium-ozone-wayland = "cast-shell"

# --- identity / brand ---
SUPERBIRD_HOSTNAME ?= "superbird"
SUPERBIRD_MDNS_SERVICE_NAME ?= "Superbird"
SUPERBIRD_USB_GADGET_NAME ?= "Superbird"
SUPERBIRD_USB_GADGET_MANUFACTURER ?= "superbird"
SUPERBIRD_USB_GADGET_PRODUCT ?= "Superbird"
SUPERBIRD_BOOT_LOGO_NAME ?= "bootup.bmp"
SUPERBIRD_WESTON_SPLASH_IMAGE ?= "bridgething-splash.png"

# --- chromium kiosk ---
CHROMIUM_KIOSK_URL ?= "about:blank"
CHROMIUM_KIOSK_PROXY_SERVER ?= ""

# --- OTA range proxy ---
SUPERBIRD_OTA_RANGE_PORT ?= "8893"
SUPERBIRD_OTA_DELTA_URL_BASE ?= "http://127.0.0.1:${SUPERBIRD_OTA_RANGE_PORT}"

# --- partition geometry (MiB) ---
SUPERBIRD_ENV_PART_SIZE ?= "8"
SUPERBIRD_BOOT_PART_SIZE ?= "64"
SUPERBIRD_ROOT_PART_SIZE ?= "516"
SUPERBIRD_BANDAID_PART_SIZE ?= "192"

# wic's --fstype on root_X tracks the actual rootfs format so its size check matches.
SUPERBIRD_WKS_ROOTFS_FSTYPE ??= "${@'squashfs' if 'squashfs' in (d.getVar('IMAGE_FSTYPES') or '') else 'ext4'}"

# --- OTA headroom invariant ---
# floor for the smallest stock superbird eMMC variant. raise for larger media.
SUPERBIRD_MIN_EMMC_SIZE_MIB ?= "3600"
SUPERBIRD_OTA_HEADROOM_MARGIN_SIZE ?= "64"
SUPERBIRD_REQUIRE_OTA_HEADROOM ?= "1"

# --- boot policy ---
SUPERBIRD_SLOT_INITIAL_TRIES ?= "3"
SUPERBIRD_QUICK_BOOT ?= "0"
```

## meta-superbird/conf/layer.conf
```bitbake
BBPATH .= ":${LAYERDIR}"

BBFILES += "${LAYERDIR}/recipes-*/*/*.bb \
            ${LAYERDIR}/recipes-*/*/*.bbappend"

BBFILE_COLLECTIONS += "superbird"
BBFILE_PATTERN_superbird = "^${LAYERDIR}/"
BBFILE_PRIORITY_superbird = "10"

LAYERSERIES_COMPAT_superbird = "scarthgap wrynose"

# meta-meson tracks Yocto codenames on its own cadence; its own
# layer.conf advertises only the codenames it has explicitly tested,
# which historically lags poky by ~6 months. Append wrynose locally
# so its layer.conf passes parsing on a wrynose-targeted poky tip.
# Drop this override once meta-meson upstream lists wrynose.
LAYERSERIES_COMPAT_meson:append = " wrynose"

LAYERDEPENDS_superbird = "core meson chromium-browser-layer"

# Capture the layer root so the flashthing image class can find
# helper scripts shipped alongside the class itself.
SUPERBIRD_LAYERDIR := "${LAYERDIR}"
```

## meta-superbird/conf/machine/superbird.conf
```bitbake
#@TYPE: Machine
#@NAME: Spotify Car Thing (Superbird)
#@DESCRIPTION: Mainline-kernel Car Thing - Amlogic S905D2 (G12A family)

require conf/machine/include/amlogic-s905d2.inc

PREFERRED_PROVIDER_virtual/kernel = "linux-superbird"

# superbird-uboot and stock u-boot both PROVIDE virtual/bootloader; pin ours.
PREFERRED_PROVIDER_virtual/bootloader = "superbird-uboot"

KERNEL_IMAGETYPE = "Image"

KERNEL_DEVICETREE = "amlogic/meson-g12a-superbird.dtb"

# kernel + dtb + extlinux.conf land under /extlinux/ so extlinux.conf's relative
# KERNEL/FDT paths resolve against its own directory. logo.bmp sits at the root
# of boot_X vfat for u-boot's carthing_show_splash to fs_read at /logo.bmp.
IMAGE_BOOT_FILES = "Image;extlinux/Image meson-g12a-superbird.dtb;extlinux/meson-g12a-superbird.dtb extlinux.conf;extlinux/extlinux.conf logo.bmp;logo.bmp"

SERIAL_CONSOLES = "115200;ttyAML0"

MACHINE_FEATURES = "alsa bluetooth ext2 screen usbgadget usbhost vfat"

# static device facts surfaced into /etc/superbird by the device init recipe
SUPERBIRD_FCC_ID = "2AP3D"
SUPERBIRD_IC_ID = "24262"
SUPERBIRD_MODEL_NAME = "YX5H6679"
SUPERBIRD_DESCRIPTION = "Spotify Car Thing (Superbird) running Bridgething"

IMAGE_FSTYPES = "ext4 tar.bz2"
```

## meta-superbird/files/wic/superbird-mainline.wks
```
# Mainline u-boot wic layout: symmetric A/B slots + env + bandaid overlay.
# Both slots ship identical content at factory-flash, so either boots from
# boot 1; A/B selection state lives in uboot.env and OTA writes the inactive
# slot. The data partition is carved by superbird-provision on first boot.
#
#   env     8 MiB   vfat       uboot.env (CONFIG_ENV_FAT, "0#env")
#   boot_a 32 MiB   vfat       kernel + dtb + extlinux/extlinux.conf
#   root_a 516 MiB  squashfs   read-only rootfs (active slot's root=)
#   boot_b 32 MiB   vfat       mirror of boot_a at factory
#   root_b 516 MiB  squashfs   mirror of root_a at factory
#   bandaid 64 MiB  ext4       overlay-upper layer for in-place patches
#   data   rest     ext4       carved by superbird-provision on first boot

part env     --source rawcopy --sourceparams="file=superbird-uenv.vfat" --part-name env     --label env     --fstype=vfat     --align 4096 --fixed-size 8M
part boot_a  --source bootimg-partition                                 --part-name boot_a  --label boot_a  --fstype=vfat     --align 4096 --fixed-size 32M
part root_a  --source rootfs                                            --part-name root_a                  --fstype=squashfs --align 4096 --fixed-size 516M
part boot_b  --source bootimg-partition                                 --part-name boot_b  --label boot_b  --fstype=vfat     --align 4096 --fixed-size 32M
part root_b  --source rootfs                                            --part-name root_b                  --fstype=squashfs --align 4096 --fixed-size 516M
part bandaid                                                            --part-name bandaid --label bandaid --fstype=ext4     --align 4096 --fixed-size 64M

bootloader --ptable gpt
```
