## examples/meta-superbird-mic-debug/conf/distro/superbird-mic-debug.conf
```bitbake
require conf/distro/superbird.conf

DISTRO = "superbird-mic-debug"
DISTRO_NAME = "Superbird Mic Debug"
DISTRO_VERSION = "0.1.0"

SUPERBIRD_HOSTNAME = "mic-debug"
SUPERBIRD_MDNS_SERVICE_NAME = "Mic Debug"
SUPERBIRD_USB_GADGET_NAME = "mic-debug"
SUPERBIRD_USB_GADGET_MANUFACTURER = "bridgething"
SUPERBIRD_USB_GADGET_PRODUCT = "Superbird Mic Debug"

CHROMIUM_KIOSK_URL = "http://127.0.0.1:8099/"
```

## examples/meta-superbird-mic-debug/conf/layer.conf
```bitbake
BBPATH .= ":${LAYERDIR}"
BBFILES += "${LAYERDIR}/recipes-*/*/*.bb ${LAYERDIR}/recipes-*/*/*.bbappend"

BBFILE_COLLECTIONS += "superbird-mic-debug"
BBFILE_PATTERN_superbird-mic-debug := "^${LAYERDIR}/"
BBFILE_PRIORITY_superbird-mic-debug = "20"

LAYERVERSION_superbird-mic-debug = "1"
LAYERSERIES_COMPAT_superbird-mic-debug = "scarthgap wrynose"
LAYERDEPENDS_superbird-mic-debug = "core superbird meson chromium-browser-layer"
```
